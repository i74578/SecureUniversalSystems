#include <Nokia_LCD.h>
#include <Wire.h>

#define pot_in A0
int input;
byte current_num;
Nokia_LCD lcd(D8, D7, D6, D5, D4);  // Initialize Nokia 5510 display; adjust pins as needed

const long interval = 2000;  // Time interval for number acceptance
unsigned long previousMillis = 0;
unsigned long currentMillis = 0;
int place = 0;  // Place on the LCD display
byte password[4] = { 1, 2, 3, 4 };
byte enteredPassword[4];
byte temp_num = 20;
bool allowed_access = true;
bool locked = true;

const unsigned char SUS_logo[4032] = {
0x5F, 0x5F, 0x5F, 0x5F, 0x5F, 0x5F, 0x5F, 0x5F, 0x5F, 0x5F,
0x5F, 0x5F, 0x5F, 0x5F, 0x5F, 0x5F, 0x5F, 0x60, 0x60, 0x5F,
0x5F, 0x5E, 0x5E, 0x5E, 0x5E, 0x5F, 0x5E, 0x5E, 0x5E, 0x5F,
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0x5F, 0x5F};
void setup() {
  Serial.begin(15200);
  pinMode(pot_in, INPUT_PULLUP);  // Initialize potentiometer

  // Initialize Nokia 5510 LCD display
  lcd.begin();
  lcd.setContrast(60);
  lcd.clear();

  // Display initial text
  lcd.setCursor(0, 0);
  lcd.print("Enter password");
}

void loop() {
  if (locked) {
    // Processing input from potentiometer
    input = analogRead(pot_in);
    current_num = (byte)map(input, 10, 1023, 0, 9);

    // Display current number
    lcd.setCursor(place * 15, 1);
    lcd.print(current_num);

    if (current_num != temp_num) {
      temp_num = current_num;
      currentMillis = millis();
      previousMillis = currentMillis;
    } else {
      currentMillis = millis();
    }

    // Timer
    if (currentMillis - previousMillis >= interval && current_num == temp_num) {
      previousMillis = currentMillis;
      //lcd.setCursor(place, 1);
      //lcd.print(current_num);
      enteredPassword[place] = current_num;
      place++;

      if (place >= 4) {
        allowed_access = true;
        for (int i = 0; i < place; i++) {
          if (password[i] != enteredPassword[i]) {
            allowed_access = false;
          }
        }

        if (allowed_access) {
          lcd.clear();
          lcd.setCursor(0, 0);
          lcd.print("DOOR IS OPEN!");  // Unlock
          delay(3000);
          lcd.draw(SUS_logo,
                   sizeof(SUS_logo) / sizeof(SUS_logo[0]),
                   true);
          delay(10000);
          locked = false;
        } else {
          lcd.clear();
          lcd.setCursor(0, 0);
          lcd.print("ACCESS DENIED");  // Deny access
          delay(2000);
          place = 0;
          lcd.clear();
          lcd.setCursor(0, 0);
          lcd.print("Enter Password");
          temp_num = 15;
        }
      }
    }
  }
}
